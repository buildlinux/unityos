## conf/bblayers.conf
```bitbake
# POKY_BBLAYERS_CONF_VERSION is increased each time build/conf/bblayers.conf
# changes incompatibly
POKY_BBLAYERS_CONF_VERSION = "2"

BBPATH = "${TOPDIR}"
BBFILES ?= ""

BBLAYERS ?= " \
  /home/sandesh/unityos.git/poky/meta \
  /home/sandesh/unityos.git/poky/meta-poky \
  /home/sandesh/unityos.git/poky/meta-yocto-bsp \
  "
```
